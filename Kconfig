## Kconfig
```kconfig
menu "Menu8g2 Config"
    config MENU8G2_INDICATOR
        string
        prompt "prefix to apply for address data"
        default " > "
        help
            Prepended to selected menu option

    config MENU8G2_BORDER_SIZE
        int
        prompt "Blank boudary around options"
        default 1
        help
            help text here
    config MENU8G2_LINE_BUFFER_LEN
        int
        prompt "Buffer size for a single line string on the display"
        default 80
        help
            help text here

    choice
        prompt "Select Menu Header Justification"
        config MENU8G2_HEADER_CENTER_JUST
            bool "Header String is Centered"
        config MENU8G2_HEADER_LEFT_JUST
            bool "Header String is Left Justified"
    endchoice

    choice
        prompt "Select U8G2 Buffer Method"
        config MENU8G2_BUFFER_FULL
            bool "Full Buffer Method (fast, high ram, allows screen saves)"
        config MENU8G2_BUFFER_PAGE
            bool "Paged Buffer (slow, low ram, no screen saves)"
    endchoice

endmenu
```

## Kconfig.projbuild
```kconfig
menu "MenU8G2 Config"

config MAX_DEPTH
    int
    prompt "Maximum menu depth. I.E. how large the menuing stack size is"
    default 6
    help
        A lower value uses less memory, but a higher value allows you to have 
        deeper submenus.

endmenu
```
